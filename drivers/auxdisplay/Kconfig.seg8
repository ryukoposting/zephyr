## drivers/auxdisplay/Kconfig.seg8
```kconfig
# Copyright (c) 2024 Evan Perry Grove
# SPDX-License-Identifier: Apache-2.0

config AUXDISPLAY_SEG8
    bool "SEG8 driver"
    default y
    depends on DT_HAS_EPG_SEG8_ENABLED
    help
      Enable driver Evan's SEG8 display controller.
```

## drivers/wifi/esp_at/Kconfig.esp_at_bt
```kconfig
# ESP-AT Bluetooth shim configuration
#
# Copyright (c) 2023 Evan Perry Grove

config WIFI_ESP_BLUETOOTH_SHIM
	bool "ESP-AT BLE peripheral shim"
	depends on BT_CUSTOM
    depends on SYS_MEM_BLOCKS

if WIFI_ESP_BLUETOOTH_SHIM

config BT_DEVICE_NAME
    string "Bluetooth device name"
    default "Zephyr"

config BT_PRIVACY
    bool "Bluetooth privacy"
    help
      This causes the device to use resolvable private addresses (RPAs).

config BT_MAX_ATTRS
    int "Max GATT Attributes"
    default 32

config BT_MAX_ATT_MTU
    int "Max ATT MTU"
    default 251

config BT_MAX_CONN
    int "Max BT connections"
    default 1

endif
```

## dts/bindings/auxdisplay/epg,seg8.yaml
```yaml
#
# Copyright (c) 2024 Evan Perry Grove
#
# SPDX-License-Identifier: Apache-2.0
#

description: SEG8 Display Controller

compatible: "epg,seg8"

include: [auxdisplay-device.yaml]

properties:
  segment-gpios:
    type: phandle-array
    required: true
    description: |
      Array of GPIOs that set the display's segments.
      Must be in order from A-G.

  digit-select-gpios:
    type: phandle-array
    required: true
    description: |
      Array of GPIOs that select the display's digits.
      Must be in order of left-to-right.
```

## subsys/rust/Kconfig
```kconfig
# Copyright (c) 2025 Evan Perry Grove
# SPDX-License-Identifier: Apache-2.0

menuconfig RUST
	bool "Zephyr Rust Integration"
	select EXPERIMENTAL

config RUST_TARGET
	string "Target triplet passed to rustc during library builds"
	# arm
	default "thumbv7em-none-eabihf" if ARMV7_M_ARMV8_M_MAINLINE && FPU
	default "thumbv6m-none-eabi" if ARMV6_M_ARMV8_M_BASELINE && !FPU
	default "thumbv7em-none-eabihf" if ARMV7_M_ARMV8_M_MAINLINE && FPU
	default "thumbv6m-none-eabi" if ARMV6_M_ARMV8_M_BASELINE && !FPU
	# x86
	default "x86_64-unknown-uefi" if ARCH_X86 && X86_64 && X86_EFI
	default "x86_64-unknown-none" if ARCH_X86 && X86_64 && !X86_EFI
	default "i686-unknown-uefi" if ARCH_X86 && !X86_64 && X86_EFI
	default "i686-unknown-none" if ARCH_X86 && !X86_64 && !X86_EFI
	# posix defaults are handled in cmake/get_target.cmake so that we can
	# take advantage of CMake's host info variables
```
