## CMakeLists.txt
```
# SPDX-License-Identifier: Apache-2.0

cmake_minimum_required(VERSION 3.20.0)
find_package(Zephyr REQUIRED HINTS $ENV{ZEPHYR_BASE})
project(external_lib_rust)

target_sources(app PRIVATE src/main.c)

zephyr_add_rust_library(mylib
	PROFILE release
)

target_link_libraries(app PUBLIC mylib)
```

## sample.yaml
```
sample:
  name: External Rust Library
tests:
  sample.app_dev.external_lib:
    integration_platforms:
      - native_sim
    tags: external
    harness: console
    harness_config:
      type: multi_line
      regex:
        - "The sum of 123 and 234 is 357!"
```

## prj.conf
```kconfig
CONFIG_RUST=y
CONFIG_STDOUT_CONSOLE=y
CONFIG_PRINTK=y
```

## src/main.c
```c
#include <zephyr/kernel.h>
#include <mylib/bindings.h>

int main()
{
	Sum sum;
	sum.x = 123;
	sum.y = 234;
	print_sum(&sum);

	return 0;
}

void rust_panic()
{
	k_panic();
}
```
